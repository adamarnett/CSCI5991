## week04/asyncSerial/build/Kconfig/Kconfig.shield
```kconfig
osource "/home/adam/asyncSerial/boards/shields/*/Kconfig.shield"
osource "/home/adam/ncs/v2.9.0/nrf/boards/shields/*/Kconfig.shield"
```

## week05/asyncSerial/build/Kconfig/Kconfig.shield.defconfig
```kconfig
osource "/home/adam/asyncSerial/boards/shields/*/Kconfig.defconfig"
osource "/home/adam/ncs/v2.9.0/nrf/boards/shields/*/Kconfig.defconfig"
```

## week05/asyncSerial/build/asyncSerial/Kconfig/boards/Kconfig
```kconfig
# Load Zephyr board Kconfig descriptions.
osource "/home/adam/ncs/v2.9.0/zephyr/boards/nordic/nrf52840dk/Kconfig"
```

## week05/qspi0/build/Kconfig/boards/Kconfig.defconfig
```kconfig
# Load Zephyr board defconfig descriptions.
osource "/home/adam/ncs/v2.9.0/zephyr/boards/nordic/nrf52840dk/Kconfig.defconfig"
```

## week05/qspiFlash/build/qspiFlash/Kconfig/arch/Kconfig
```kconfig
# Load Zephyr Arch Kconfig descriptions.
osource "/home/adam/ncs/v2.9.0/zephyr/arch/x86/Kconfig"
osource "/home/adam/ncs/v2.9.0/zephyr/arch/xtensa/Kconfig"
osource "/home/adam/ncs/v2.9.0/zephyr/arch/sparc/Kconfig"
osource "/home/adam/ncs/v2.9.0/zephyr/arch/riscv/Kconfig"
osource "/home/adam/ncs/v2.9.0/zephyr/arch/posix/Kconfig"
osource "/home/adam/ncs/v2.9.0/zephyr/arch/nios2/Kconfig"
osource "/home/adam/ncs/v2.9.0/zephyr/arch/mips/Kconfig"
osource "/home/adam/ncs/v2.9.0/zephyr/arch/arm64/Kconfig"
osource "/home/adam/ncs/v2.9.0/zephyr/arch/arm/Kconfig"
osource "/home/adam/ncs/v2.9.0/zephyr/arch/arc/Kconfig"
```

## week09/Kconfig.quadalpha
```kconfig
config AUXDISPLAY_QUADALPHA
	bool "SparkFun Quad Alphnumeric 14-segment driver"
	default y
	select I2C
	depends on DT_HAS_SPARKFUN_QUADALPHA_ENABLED
	help
	  Enable driver for SparkFun Quad Alphnumeric.
```

## week1/button_blinky/sample.yaml
```yaml
sample:
  name: Circle Blinky
tests:
  circle_blinky:
    tags:
      - LED
      - gpio
    filter: dt_enabled_alias_with_parent_compat("led0", "gpio-leds")
    depends_on: gpio
    harness: led
    integration_platforms:
      - frdm_k64f
```

## week10/ac780s driver/zephyr_drivers_auxdisplay/Kconfig.ac780s
```kconfig
# Copyright (c) 2025 Adam Arnett <adamarnett@proton.me>
# SPDX-License-Identifier: Apache-2.0

config AUXDISPLAY_AC780S
	bool "Orient Display AC780S dot character LCD driver"
	default y
	select I2C
	depends on DT_HAS_AC780S_ENABLED
	help
	  Enable driver for Orient Display AC780S LCD controller.
```

## week10/ac780s/build/Kconfig/arch/Kconfig
```kconfig
# Load Zephyr Arch Kconfig descriptions.
osource "/home/adam/ncsII/ncs/main/zephyr/arch/x86/Kconfig"
osource "/home/adam/ncsII/ncs/main/zephyr/arch/xtensa/Kconfig"
osource "/home/adam/ncsII/ncs/main/zephyr/arch/sparc/Kconfig"
osource "/home/adam/ncsII/ncs/main/zephyr/arch/riscv/Kconfig"
osource "/home/adam/ncsII/ncs/main/zephyr/arch/posix/Kconfig"
osource "/home/adam/ncsII/ncs/main/zephyr/arch/nios2/Kconfig"
osource "/home/adam/ncsII/ncs/main/zephyr/arch/mips/Kconfig"
osource "/home/adam/ncsII/ncs/main/zephyr/arch/arm64/Kconfig"
osource "/home/adam/ncsII/ncs/main/zephyr/arch/arm/Kconfig"
osource "/home/adam/ncsII/ncs/main/zephyr/arch/arc/Kconfig"
```

## week12/test0/build/test0/Kconfig/boards/Kconfig.native_sim
```kconfig
# Load board Kconfig descriptions.
osource "/home/adam/ncsII/ncs/main/zephyr/boards/native/native_sim/Kconfig.native_sim"
```

## week13/test0/build/Kconfig/arch/Kconfig
```kconfig
# Load Zephyr Arch Kconfig descriptions.
osource "/home/adam/myZeph/zephyr/arch/x86/Kconfig"
osource "/home/adam/myZeph/zephyr/arch/xtensa/Kconfig"
osource "/home/adam/myZeph/zephyr/arch/sparc/Kconfig"
osource "/home/adam/myZeph/zephyr/arch/riscv/Kconfig"
osource "/home/adam/myZeph/zephyr/arch/posix/Kconfig"
osource "/home/adam/myZeph/zephyr/arch/nios2/Kconfig"
osource "/home/adam/myZeph/zephyr/arch/mips/Kconfig"
osource "/home/adam/myZeph/zephyr/arch/arm64/Kconfig"
osource "/home/adam/myZeph/zephyr/arch/arm/Kconfig"
osource "/home/adam/myZeph/zephyr/arch/arc/Kconfig"
```

## week13/test0/build/Kconfig/boards/Kconfig.defconfig
```kconfig
# Load Zephyr board defconfig descriptions.
osource "/home/adam/myZeph/zephyr/boards/native/native_sim/Kconfig.defconfig"
```

## week13/test0/build/Kconfig/boards/Kconfig.native_sim
```kconfig
# Load board Kconfig descriptions.
osource "/home/adam/myZeph/zephyr/boards/native/native_sim/Kconfig.native_sim"
```

## week13/test0/build/Kconfig/boards/Kconfig.sysbuild
```kconfig
# Load Sysbuild board Kconfig descriptions.
osource "/home/adam/myZeph/zephyr/boards/native/native_sim/Kconfig.sysbuild"
```

## week13/test0/build/Kconfig/soc/Kconfig
```kconfig
# Load Zephyr SoC Kconfig descriptions.
osource "/home/adam/myZeph/zephyr/soc/xlnx/zynqmp/Kconfig"
osource "/home/adam/myZeph/zephyr/soc/xlnx/zynq7000/Kconfig"
osource "/home/adam/myZeph/zephyr/soc/xen/Kconfig"
osource "/home/adam/myZeph/zephyr/soc/wch/ch32v/Kconfig"
osource "/home/adam/myZeph/zephyr/soc/ti/simplelink/Kconfig"
osource "/home/adam/myZeph/zephyr/soc/ti/lm3s6965/Kconfig"
osource "/home/adam/myZeph/zephyr/soc/ti/k3/Kconfig"
osource "/home/adam/myZeph/zephyr/soc/telink/tlsr/Kconfig"
osource "/home/adam/myZeph/zephyr/soc/starfive/jh71xx/Kconfig"
osource "/home/adam/myZeph/zephyr/soc/st/stm32/Kconfig"
osource "/home/adam/myZeph/zephyr/soc/snps/qemu_arc/Kconfig"
osource "/home/adam/myZeph/zephyr/soc/snps/nsim/arc_v/Kconfig"
osource "/home/adam/myZeph/zephyr/soc/snps/nsim/arc_classic/Kconfig"
osource "/home/adam/myZeph/zephyr/soc/snps/hsdk4xd/Kconfig"
osource "/home/adam/myZeph/zephyr/soc/snps/hsdk/Kconfig"
osource "/home/adam/myZeph/zephyr/soc/snps/emsk/Kconfig"
osource "/home/adam/myZeph/zephyr/soc/snps/emsdp/Kconfig"
osource "/home/adam/myZeph/zephyr/soc/snps/arc_iot/Kconfig"
osource "/home/adam/myZeph/zephyr/soc/silabs/Kconfig"
osource "/home/adam/myZeph/zephyr/soc/sifive/sifive_freedom/Kconfig"
osource "/home/adam/myZeph/zephyr/soc/sensry/Kconfig"
osource "/home/adam/myZeph/zephyr/soc/rockchip/Kconfig"
osource "/home/adam/myZeph/zephyr/soc/renode/riscv_virtual/Kconfig"
osource "/home/adam/myZeph/zephyr/soc/renode/cortex_r8_virtual/Kconfig"
osource "/home/adam/myZeph/zephyr/soc/renesas/smartbond/Kconfig"
osource "/home/adam/myZeph/zephyr/soc/renesas/rzt2m/Kconfig"
osource "/home/adam/myZeph/zephyr/soc/renesas/rz/Kconfig"
osource "/home/adam/myZeph/zephyr/soc/renesas/rcar/Kconfig"
osource "/home/adam/myZeph/zephyr/soc/renesas/ra/Kconfig"
osource "/home/adam/myZeph/zephyr/soc/realtek/ec/Kconfig"
osource "/home/adam/myZeph/zephyr/soc/raspberrypi/rpi_pico/Kconfig"
osource "/home/adam/myZeph/zephyr/soc/quicklogic/eos_s3/Kconfig"
osource "/home/adam/myZeph/zephyr/soc/qemu/virt_riscv/Kconfig"
osource "/home/adam/myZeph/zephyr/soc/qemu/malta/Kconfig"
osource "/home/adam/myZeph/zephyr/soc/openisa/rv32m1/Kconfig"
osource "/home/adam/myZeph/zephyr/soc/nxp/s32/Kconfig"
osource "/home/adam/myZeph/zephyr/soc/nxp/rw/Kconfig"
osource "/home/adam/myZeph/zephyr/soc/nxp/mcx/Kconfig"
osource "/home/adam/myZeph/zephyr/soc/nxp/lpc/Kconfig"
osource "/home/adam/myZeph/zephyr/soc/nxp/layerscape/Kconfig"
osource "/home/adam/myZeph/zephyr/soc/nxp/kinetis/Kconfig"
osource "/home/adam/myZeph/zephyr/soc/nxp/imxrt/Kconfig"
osource "/home/adam/myZeph/zephyr/soc/nxp/imx/Kconfig"
osource "/home/adam/myZeph/zephyr/soc/nuvoton/numicro/Kconfig"
osource "/home/adam/myZeph/zephyr/soc/nuvoton/numaker/Kconfig"
osource "/home/adam/myZeph/zephyr/soc/nuvoton/npcx/Kconfig"
osource "/home/adam/myZeph/zephyr/soc/nuvoton/npcm/Kconfig"
osource "/home/adam/myZeph/zephyr/soc/nordic/Kconfig"
osource "/home/adam/myZeph/zephyr/soc/neorv32/Kconfig"
osource "/home/adam/myZeph/zephyr/soc/native/inf_clock/Kconfig"
osource "/home/adam/myZeph/zephyr/soc/microchip/miv/Kconfig"
osource "/home/adam/myZeph/zephyr/soc/microchip/mec/Kconfig"
osource "/home/adam/myZeph/zephyr/soc/mediatek/mt8xxx/Kconfig"
osource "/home/adam/myZeph/zephyr/soc/lowrisc/opentitan/Kconfig"
osource "/home/adam/myZeph/zephyr/soc/litex/litex_vexriscv/Kconfig"
osource "/home/adam/myZeph/zephyr/soc/ite/ec/Kconfig"
osource "/home/adam/myZeph/zephyr/soc/intel/raptor_lake/Kconfig"
osource "/home/adam/myZeph/zephyr/soc/intel/lakemont/Kconfig"
osource "/home/adam/myZeph/zephyr/soc/intel/intel_socfpga_std/Kconfig"
osource "/home/adam/myZeph/zephyr/soc/intel/intel_socfpga/Kconfig"
osource "/home/adam/myZeph/zephyr/soc/intel/intel_niosv/Kconfig"
osource "/home/adam/myZeph/zephyr/soc/intel/intel_ish/Kconfig"
osource "/home/adam/myZeph/zephyr/soc/intel/intel_adsp/Kconfig"
osource "/home/adam/myZeph/zephyr/soc/intel/elkhart_lake/Kconfig"
osource "/home/adam/myZeph/zephyr/soc/intel/atom/Kconfig"
osource "/home/adam/myZeph/zephyr/soc/intel/apollo_lake/Kconfig"
osource "/home/adam/myZeph/zephyr/soc/intel/alder_lake/Kconfig"
osource "/home/adam/myZeph/zephyr/soc/infineon/cat3/Kconfig"
osource "/home/adam/myZeph/zephyr/soc/infineon/cat1b/Kconfig"
osource "/home/adam/myZeph/zephyr/soc/infineon/cat1a/Kconfig"
osource "/home/adam/myZeph/zephyr/soc/gd/gd32/Kconfig"
osource "/home/adam/myZeph/zephyr/soc/gaisler/leon3/Kconfig"
osource "/home/adam/myZeph/zephyr/soc/gaisler/gr716a/Kconfig"
osource "/home/adam/myZeph/zephyr/soc/espressif/Kconfig"
osource "/home/adam/myZeph/zephyr/soc/ene/kb1200/Kconfig"
osource "/home/adam/myZeph/zephyr/soc/efinix/sapphire/Kconfig"
osource "/home/adam/myZeph/zephyr/soc/cdns/xtensa_sample_controller/Kconfig"
osource "/home/adam/myZeph/zephyr/soc/cdns/sample_controller32/Kconfig"
osource "/home/adam/myZeph/zephyr/soc/cdns/dc233c/Kconfig"
osource "/home/adam/myZeph/zephyr/soc/brcm/bcmvk/Kconfig"
osource "/home/adam/myZeph/zephyr/soc/brcm/bcm2712/Kconfig"
osource "/home/adam/myZeph/zephyr/soc/brcm/bcm2711/Kconfig"
osource "/home/adam/myZeph/zephyr/soc/atmel/sam0/Kconfig"
osource "/home/adam/myZeph/zephyr/soc/atmel/sam/Kconfig"
osource "/home/adam/myZeph/zephyr/soc/aspeed/Kconfig"
osource "/home/adam/myZeph/zephyr/soc/arm/Kconfig"
osource "/home/adam/myZeph/zephyr/soc/arm/beetle/Kconfig"
osource "/home/adam/myZeph/zephyr/soc/antmicro/myra/Kconfig"
osource "/home/adam/myZeph/zephyr/soc/andestech/Kconfig"
osource "/home/adam/myZeph/zephyr/soc/amd/acp_6_0/Kconfig"
osource "/home/adam/myZeph/zephyr/soc/ambiq/Kconfig"
osource "/home/adam/myZeph/zephyr/soc/altr/zephyr_nios2f/Kconfig"
osource "/home/adam/myZeph/zephyr/soc/altr/qemu_nios2/Kconfig"
osource "/home/adam/myZeph/zephyr/soc/adi/max32/Kconfig"
```
