## week13/test0/build/Kconfig/soc/Kconfig.sysbuild
```kconfig
# Load Sysbuild SoC Kconfig descriptions.
osource "/home/adam/myZeph/zephyr/soc/xlnx/zynqmp/Kconfig.sysbuild"
osource "/home/adam/myZeph/zephyr/soc/xlnx/zynq7000/Kconfig.sysbuild"
osource "/home/adam/myZeph/zephyr/soc/xen/Kconfig.sysbuild"
osource "/home/adam/myZeph/zephyr/soc/wch/ch32v/Kconfig.sysbuild"
osource "/home/adam/myZeph/zephyr/soc/ti/simplelink/Kconfig.sysbuild"
osource "/home/adam/myZeph/zephyr/soc/ti/lm3s6965/Kconfig.sysbuild"
osource "/home/adam/myZeph/zephyr/soc/ti/k3/Kconfig.sysbuild"
osource "/home/adam/myZeph/zephyr/soc/telink/tlsr/Kconfig.sysbuild"
osource "/home/adam/myZeph/zephyr/soc/starfive/jh71xx/Kconfig.sysbuild"
osource "/home/adam/myZeph/zephyr/soc/st/stm32/Kconfig.sysbuild"
osource "/home/adam/myZeph/zephyr/soc/snps/qemu_arc/Kconfig.sysbuild"
osource "/home/adam/myZeph/zephyr/soc/snps/nsim/arc_v/Kconfig.sysbuild"
osource "/home/adam/myZeph/zephyr/soc/snps/nsim/arc_classic/Kconfig.sysbuild"
osource "/home/adam/myZeph/zephyr/soc/snps/hsdk4xd/Kconfig.sysbuild"
osource "/home/adam/myZeph/zephyr/soc/snps/hsdk/Kconfig.sysbuild"
osource "/home/adam/myZeph/zephyr/soc/snps/emsk/Kconfig.sysbuild"
osource "/home/adam/myZeph/zephyr/soc/snps/emsdp/Kconfig.sysbuild"
osource "/home/adam/myZeph/zephyr/soc/snps/arc_iot/Kconfig.sysbuild"
osource "/home/adam/myZeph/zephyr/soc/silabs/Kconfig.sysbuild"
osource "/home/adam/myZeph/zephyr/soc/sifive/sifive_freedom/Kconfig.sysbuild"
osource "/home/adam/myZeph/zephyr/soc/sensry/Kconfig.sysbuild"
osource "/home/adam/myZeph/zephyr/soc/rockchip/Kconfig.sysbuild"
osource "/home/adam/myZeph/zephyr/soc/renode/riscv_virtual/Kconfig.sysbuild"
osource "/home/adam/myZeph/zephyr/soc/renode/cortex_r8_virtual/Kconfig.sysbuild"
osource "/home/adam/myZeph/zephyr/soc/renesas/smartbond/Kconfig.sysbuild"
osource "/home/adam/myZeph/zephyr/soc/renesas/rzt2m/Kconfig.sysbuild"
osource "/home/adam/myZeph/zephyr/soc/renesas/rz/Kconfig.sysbuild"
osource "/home/adam/myZeph/zephyr/soc/renesas/rcar/Kconfig.sysbuild"
osource "/home/adam/myZeph/zephyr/soc/renesas/ra/Kconfig.sysbuild"
osource "/home/adam/myZeph/zephyr/soc/realtek/ec/Kconfig.sysbuild"
osource "/home/adam/myZeph/zephyr/soc/raspberrypi/rpi_pico/Kconfig.sysbuild"
osource "/home/adam/myZeph/zephyr/soc/quicklogic/eos_s3/Kconfig.sysbuild"
osource "/home/adam/myZeph/zephyr/soc/qemu/virt_riscv/Kconfig.sysbuild"
osource "/home/adam/myZeph/zephyr/soc/qemu/malta/Kconfig.sysbuild"
osource "/home/adam/myZeph/zephyr/soc/openisa/rv32m1/Kconfig.sysbuild"
osource "/home/adam/myZeph/zephyr/soc/nxp/s32/Kconfig.sysbuild"
osource "/home/adam/myZeph/zephyr/soc/nxp/rw/Kconfig.sysbuild"
osource "/home/adam/myZeph/zephyr/soc/nxp/mcx/Kconfig.sysbuild"
osource "/home/adam/myZeph/zephyr/soc/nxp/lpc/Kconfig.sysbuild"
osource "/home/adam/myZeph/zephyr/soc/nxp/layerscape/Kconfig.sysbuild"
osource "/home/adam/myZeph/zephyr/soc/nxp/kinetis/Kconfig.sysbuild"
osource "/home/adam/myZeph/zephyr/soc/nxp/imxrt/Kconfig.sysbuild"
osource "/home/adam/myZeph/zephyr/soc/nxp/imx/Kconfig.sysbuild"
osource "/home/adam/myZeph/zephyr/soc/nuvoton/numicro/Kconfig.sysbuild"
osource "/home/adam/myZeph/zephyr/soc/nuvoton/numaker/Kconfig.sysbuild"
osource "/home/adam/myZeph/zephyr/soc/nuvoton/npcx/Kconfig.sysbuild"
osource "/home/adam/myZeph/zephyr/soc/nuvoton/npcm/Kconfig.sysbuild"
osource "/home/adam/myZeph/zephyr/soc/nordic/Kconfig.sysbuild"
osource "/home/adam/myZeph/zephyr/soc/neorv32/Kconfig.sysbuild"
osource "/home/adam/myZeph/zephyr/soc/native/inf_clock/Kconfig.sysbuild"
osource "/home/adam/myZeph/zephyr/soc/microchip/miv/Kconfig.sysbuild"
osource "/home/adam/myZeph/zephyr/soc/microchip/mec/Kconfig.sysbuild"
osource "/home/adam/myZeph/zephyr/soc/mediatek/mt8xxx/Kconfig.sysbuild"
osource "/home/adam/myZeph/zephyr/soc/lowrisc/opentitan/Kconfig.sysbuild"
osource "/home/adam/myZeph/zephyr/soc/litex/litex_vexriscv/Kconfig.sysbuild"
osource "/home/adam/myZeph/zephyr/soc/ite/ec/Kconfig.sysbuild"
osource "/home/adam/myZeph/zephyr/soc/intel/raptor_lake/Kconfig.sysbuild"
osource "/home/adam/myZeph/zephyr/soc/intel/lakemont/Kconfig.sysbuild"
osource "/home/adam/myZeph/zephyr/soc/intel/intel_socfpga_std/Kconfig.sysbuild"
osource "/home/adam/myZeph/zephyr/soc/intel/intel_socfpga/Kconfig.sysbuild"
osource "/home/adam/myZeph/zephyr/soc/intel/intel_niosv/Kconfig.sysbuild"
osource "/home/adam/myZeph/zephyr/soc/intel/intel_ish/Kconfig.sysbuild"
osource "/home/adam/myZeph/zephyr/soc/intel/intel_adsp/Kconfig.sysbuild"
osource "/home/adam/myZeph/zephyr/soc/intel/elkhart_lake/Kconfig.sysbuild"
osource "/home/adam/myZeph/zephyr/soc/intel/atom/Kconfig.sysbuild"
osource "/home/adam/myZeph/zephyr/soc/intel/apollo_lake/Kconfig.sysbuild"
osource "/home/adam/myZeph/zephyr/soc/intel/alder_lake/Kconfig.sysbuild"
osource "/home/adam/myZeph/zephyr/soc/infineon/cat3/Kconfig.sysbuild"
osource "/home/adam/myZeph/zephyr/soc/infineon/cat1b/Kconfig.sysbuild"
osource "/home/adam/myZeph/zephyr/soc/infineon/cat1a/Kconfig.sysbuild"
osource "/home/adam/myZeph/zephyr/soc/gd/gd32/Kconfig.sysbuild"
osource "/home/adam/myZeph/zephyr/soc/gaisler/leon3/Kconfig.sysbuild"
osource "/home/adam/myZeph/zephyr/soc/gaisler/gr716a/Kconfig.sysbuild"
osource "/home/adam/myZeph/zephyr/soc/espressif/Kconfig.sysbuild"
osource "/home/adam/myZeph/zephyr/soc/ene/kb1200/Kconfig.sysbuild"
osource "/home/adam/myZeph/zephyr/soc/efinix/sapphire/Kconfig.sysbuild"
osource "/home/adam/myZeph/zephyr/soc/cdns/xtensa_sample_controller/Kconfig.sysbuild"
osource "/home/adam/myZeph/zephyr/soc/cdns/sample_controller32/Kconfig.sysbuild"
osource "/home/adam/myZeph/zephyr/soc/cdns/dc233c/Kconfig.sysbuild"
osource "/home/adam/myZeph/zephyr/soc/brcm/bcmvk/Kconfig.sysbuild"
osource "/home/adam/myZeph/zephyr/soc/brcm/bcm2712/Kconfig.sysbuild"
osource "/home/adam/myZeph/zephyr/soc/brcm/bcm2711/Kconfig.sysbuild"
osource "/home/adam/myZeph/zephyr/soc/atmel/sam0/Kconfig.sysbuild"
osource "/home/adam/myZeph/zephyr/soc/atmel/sam/Kconfig.sysbuild"
osource "/home/adam/myZeph/zephyr/soc/aspeed/Kconfig.sysbuild"
osource "/home/adam/myZeph/zephyr/soc/arm/Kconfig.sysbuild"
osource "/home/adam/myZeph/zephyr/soc/arm/beetle/Kconfig.sysbuild"
osource "/home/adam/myZeph/zephyr/soc/antmicro/myra/Kconfig.sysbuild"
osource "/home/adam/myZeph/zephyr/soc/andestech/Kconfig.sysbuild"
osource "/home/adam/myZeph/zephyr/soc/amd/acp_6_0/Kconfig.sysbuild"
osource "/home/adam/myZeph/zephyr/soc/ambiq/Kconfig.sysbuild"
osource "/home/adam/myZeph/zephyr/soc/altr/zephyr_nios2f/Kconfig.sysbuild"
osource "/home/adam/myZeph/zephyr/soc/altr/qemu_nios2/Kconfig.sysbuild"
osource "/home/adam/myZeph/zephyr/soc/adi/max32/Kconfig.sysbuild"
```

## week14/ac780sTesting/build/Kconfig/boards/Kconfig.defconfig
```kconfig
# Load Zephyr board defconfig descriptions.
osource "/home/adam/ncsII/ncs/main/zephyr/boards/native/native_sim/Kconfig.defconfig"
```

## week14/sgp30_driver/sgp30/Kconfig
```kconfig
# SGP30 multipixel gas sensor configuration options

config SGP30
	bool "SGP30 Multipixel Gas Sensor"
	default y
	depends on DT_HAS_SENSIRION_SGP30_ENABLED
	select I2C
	select CRC
	help
	  Enable driver for SGP30 Multipixel Gas Sensor.
```

## week15/therm/build/therm/Kconfig/boards/Kconfig.sysbuild
```kconfig
# Load Sysbuild board Kconfig descriptions.
osource "/home/adam/ncsII/ncs/main/zephyr/boards/nordic/nrf52840dk/Kconfig.sysbuild"
```

## week16/mcp9808_driver/zephyr_drivers_sensor_microchip/mcp9808/Kconfig
```kconfig
# Microchip MCP9808 high accuracy digital temperature sensor driver
#
# Copyright (c) 2025 Adam Arnett
#
# SPDX-License-Identifier: Apache-2.0

config MCP9808
	bool "MCP9808 high accuracy digital temperature sensor"
	default y
	depends on DT_HAS_MICROCHIP_MCP9808_ENABLED
    select I2C
	help
	  Enables MCP9808 high accuracy digital temperature sensor driver.
```

## week6/serLCD_IV/build/serLCD_IV/Kconfig/boards/Kconfig.defconfig
```kconfig
# Load Zephyr board defconfig descriptions.
osource "/home/adam/ncsII/ncs/main/zephyr/boards/nordic/nrf52840dk/Kconfig.defconfig"
```
