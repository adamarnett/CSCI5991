//#include <freq.h>

&i2c0 {
    serlcd@72 {
		status = "okay";
		compatible = "sparkfun,serlcd";
		reg = <0x72>;
		columns = <16>;
		rows = <2>;
		command-delay-ms = <10>;
		special-command-delay-ms = <50>;
	  };
  };

//&pinctrl {
//	i2c0_default: i2c0_default{
////
//		group1 {
//			psels = <NRF_PSEL(TWIM_SDA, 0, 29)>,
//			<NRF_PSEL(TWIM_SCL, 0, 28)>;
//			bias-pull-up;
//		};
//	};
//	i2c0_sleep: i2c0_sleep{
//		group1 {
//			psels = <NRF_PSEL(TWIM_SDA, 0, 29)>,
//				<NRF_PSEL(TWIM_SCL, 0, 28)>;
//			low-power-enable;
//		};
//	};
//};